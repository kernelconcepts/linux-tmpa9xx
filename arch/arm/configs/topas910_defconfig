## arch/arm/configs/topas910_defconfig
```kconfig
CONFIG_EXPERIMENTAL=y
# CONFIG_LOCALVERSION_AUTO is not set
CONFIG_KERNEL_LZO=y
CONFIG_SYSVIPC=y
CONFIG_POSIX_MQUEUE=y
CONFIG_IKCONFIG=y
CONFIG_IKCONFIG_PROC=y
CONFIG_LOG_BUF_SHIFT=14
# CONFIG_CC_OPTIMIZE_FOR_SIZE is not set
CONFIG_MODULES=y
CONFIG_MODULE_UNLOAD=y
CONFIG_MODVERSIONS=y
# CONFIG_LBDAF is not set
# CONFIG_BLK_DEV_BSG is not set
CONFIG_ARCH_TMPA9XX=y
CONFIG_PREEMPT=y
CONFIG_AEABI=y
# CONFIG_OABI_COMPAT is not set
CONFIG_NET=y
CONFIG_PACKET=y
CONFIG_UNIX=y
CONFIG_INET=y
CONFIG_IP_MULTICAST=y
CONFIG_IP_PNP=y
CONFIG_IP_PNP_DHCP=y
CONFIG_IP_PNP_BOOTP=y
CONFIG_IP_PNP_RARP=y
CONFIG_NET_IPIP=y
CONFIG_SYN_COOKIES=y
# CONFIG_INET_LRO is not set
# CONFIG_IPV6 is not set
# CONFIG_WIRELESS is not set
CONFIG_UEVENT_HELPER_PATH="/sbin/hotplug"
CONFIG_DEVTMPFS=y
CONFIG_DEVTMPFS_MOUNT=y
# CONFIG_FIRMWARE_IN_KERNEL is not set
CONFIG_MTD=y
CONFIG_MTD_PARTITIONS=y
CONFIG_MTD_CMDLINE_PARTS=y
CONFIG_MTD_CHAR=y
CONFIG_MTD_BLOCK=y
CONFIG_MTD_CFI=y
CONFIG_MTD_JEDECPROBE=y
CONFIG_MTD_CFI_ADV_OPTIONS=y
CONFIG_MTD_CFI_GEOMETRY=y
CONFIG_MTD_CFI_INTELEXT=y
CONFIG_MTD_CFI_AMDSTD=y
CONFIG_MTD_PHYSMAP=y
CONFIG_MTD_PHYSMAP_COMPAT=y
CONFIG_MTD_PHYSMAP_START=0x20000000
CONFIG_MTD_PHYSMAP_LEN=0x02000000
CONFIG_MTD_NAND=y
CONFIG_MTD_NAND_TMPA9XX=y
CONFIG_MTD_UBI=y
CONFIG_BLK_DEV_LOOP=y
CONFIG_MISC_DEVICES=y
CONFIG_TMPA9XX_MLDALM=y
CONFIG_TOPAS_LED=y
CONFIG_SCSI=y
CONFIG_BLK_DEV_SD=y
CONFIG_BLK_DEV_SR=y
CONFIG_CHR_DEV_SG=y
# CONFIG_SCSI_LOWLEVEL is not set
CONFIG_NETDEVICES=y
CONFIG_PHYLIB=y
CONFIG_NET_ETHERNET=y
CONFIG_DM9000=y
CONFIG_DM9000_DEBUGLEVEL=0
# CONFIG_NETDEV_1000 is not set
# CONFIG_NETDEV_10000 is not set
# CONFIG_WLAN is not set
# CONFIG_INPUT_MOUSEDEV_PSAUX is not set
CONFIG_INPUT_EVDEV=y
# CONFIG_KEYBOARD_ATKBD is not set
CONFIG_KEYBOARD_GPIO=y
# CONFIG_INPUT_MOUSE is not set
CONFIG_INPUT_TOUCHSCREEN=y
CONFIG_TOUCHSCREEN_TMPA9XX=y
# CONFIG_SERIO is not set
CONFIG_VT_HW_CONSOLE_BINDING=y
CONFIG_SERIAL_AMBA_PL011=y
CONFIG_SERIAL_AMBA_PL011_CONSOLE=y
# CONFIG_SERIAL_AMBA_PL011_CHANNEL_1 is not set
CONFIG_LEGACY_PTY_COUNT=64
CONFIG_HW_RANDOM=y
CONFIG_I2C=y
CONFIG_I2C_CHARDEV=y
CONFIG_I2C_TMPA9XX=y
CONFIG_SPI=y
CONFIG_SPI_PL022=y
CONFIG_SPI_SPIDEV=y
CONFIG_GPIO_SYSFS=y
CONFIG_GENERIC_PWM=y
CONFIG_TMPA9XX_PWM=y
CONFIG_TMPA9XX_PWM_CHANNEL_0=y
CONFIG_TMPA9XX_PWM_CHANNEL_1=y
# CONFIG_HWMON is not set
CONFIG_WATCHDOG=y
CONFIG_ARM_SP805_WATCHDOG=y
# CONFIG_MFD_SUPPORT is not set
CONFIG_FB=y
CONFIG_FB_TMPA9XX_CLCD=y
CONFIG_FB_TMPA9XX_DA=y
CONFIG_DISPLAY_SUPPORT=y
CONFIG_FRAMEBUFFER_CONSOLE=y
CONFIG_FRAMEBUFFER_CONSOLE_ROTATION=y
CONFIG_FONTS=y
CONFIG_FONT_MINI_4x6=y
CONFIG_LOGO=y
# CONFIG_LOGO_LINUX_MONO is not set
# CONFIG_LOGO_LINUX_VGA16 is not set
CONFIG_SOUND=y
CONFIG_SND=y
CONFIG_SND_MIXER_OSS=y
CONFIG_SND_PCM_OSS=y
# CONFIG_SND_DRIVERS is not set
CONFIG_SND_TMPA9XX_PCM1773=y
# CONFIG_SND_SPI is not set
CONFIG_USB_GADGET=y
CONFIG_USB_GADGET_DEBUG_FILES=y
CONFIG_USB_GADGET_VBUS_DRAW=500
CONFIG_USB_ETH=y
CONFIG_MMC=y
CONFIG_MMC_SPI=y
CONFIG_NEW_LEDS=y
CONFIG_LEDS_CLASS=y
CONFIG_LEDS_GPIO=y
CONFIG_LEDS_TRIGGERS=y
CONFIG_RTC_CLASS=y
CONFIG_RTC_DRV_TMPA9XX=y
CONFIG_AUTOFS4_FS=y
CONFIG_VFAT_FS=y
CONFIG_TMPFS=y
CONFIG_JFFS2_FS=y
CONFIG_JFFS2_SUMMARY=y
CONFIG_UBIFS_FS=y
CONFIG_UBIFS_FS_XATTR=y
CONFIG_UBIFS_FS_ADVANCED_COMPR=y
CONFIG_NFS_FS=y
CONFIG_NFS_V3=y
CONFIG_NFS_V3_ACL=y
CONFIG_ROOT_NFS=y
# CONFIG_RPCSEC_GSS_KRB5 is not set
CONFIG_NLS_CODEPAGE_437=y
CONFIG_NLS_CODEPAGE_850=y
CONFIG_NLS_ISO8859_1=y
CONFIG_NLS_ISO8859_15=y
CONFIG_NLS_UTF8=y
# CONFIG_ENABLE_WARN_DEPRECATED is not set
# CONFIG_ENABLE_MUST_CHECK is not set
CONFIG_MAGIC_SYSRQ=y
# CONFIG_RCU_CPU_STALL_DETECTOR is not set
# CONFIG_ARM_UNWIND is not set
CONFIG_CRYPTO_CBC=y
CONFIG_CRYPTO_MD5=y
CONFIG_CRYPTO_DES=y
# CONFIG_CRYPTO_ANSI_CPRNG is not set
# CONFIG_CRYPTO_HW is not set
```

## arch/arm/mach-tmpa910/Kconfig
```kconfig
if ARCH_TMPA910

choice

	prompt "Select TX09 Variant"

config CPU_TMPA910
	depends on ARCH_TMPA910
	bool "TMPA910 SoC"

config CPU_TMPA900
	depends on ARCH_TMPA910
	bool "TMPA900 SoC"

endchoice


config MACH_TOPAS910
        bool "Toshiba Topas910 TMPA910 development board"
	depends on CPU_TMPA910

config DISPLAY_GLYN_640_480
        bool "Use Glyn VGA display instead of the regular QVGA."
	depends on ARCH_TMPA910

config MACH_TOPASA900
        bool "Toshiba TopasA900 TMPA900 development board"
	depends on CPU_TMPA900

endif
```

## arch/arm/mach-tmpa9xx/Kconfig
```kconfig
if ARCH_TMPA9XX

choice

	prompt "Select TX09 Variant"

config CPU_TMPA910
	depends on ARCH_TMPA9XX
	bool "TMPA910 SoC"

config CPU_TMPA900
	depends on ARCH_TMPA9XX
	bool "TMPA900 SoC"

endchoice

choice

	prompt "Select TMPA9xx board"
        
config MACH_TOPASA900
        bool "Toshiba TopasA900 TMPA900 development board"
	depends on CPU_TMPA900

config MACH_TONGA
        bool "Glyn ARM9 / Tonga2 board"
	depends on CPU_TMPA900
	select HAVE_PWM

config MACH_TONGA2_TFTTIMER
        bool "TFTTimer / Tonga2 board"
	depends on CPU_TMPA900
	select HAVE_PWM

endchoice        

config MACH_TOPAS910
        bool "Toshiba Topas910 TMPA910 development board"
	depends on CPU_TMPA910

endif
```

## drivers/pwm/Kconfig
```kconfig
#
# PWM infrastructure and devices
#

menuconfig GENERIC_PWM
	tristate "PWM Support"
	help
	  Enables PWM device support implemented via a generic
	  framework.  If unsure, say N.

config GPIO_PWM
       tristate "GPIO+hrtimer PWM device emulation"
       depends on GENERIC_PWM
       help
         When enabled, this feature emulates single-channel PWM
	 devices using high-resolution timers and GPIO pins.  You may
	 create as many of these devices as desired, subject to CPU
	 throughput limitations and GPIO pin availability.

	 To compile this feature as a module, chose M here; the module
	 will be called gpio-pwm.  If unsure, say N.

config TMPA9XX_PWM
       tristate "TMPA9xx PWM support"
       depends on GENERIC_PWM && ARCH_TMPA9XX
       help
         This option enables device driver support for the PWMC
         peripheral channels found TMPA9xx based processors.
         If unsure, say N.

config TMPA9XX_PWM_CANNEL_0
       bool "Enable PWM Channel 0"
       depends on TMPA9XX_PWM
       help
         Make use of Channel 0 (on Timer 0)

config TMPA9XX_PWM_CANNEL_1
       bool "Enable PWM Channel 1"
       depends on TMPA9XX_PWM
       help
         Make use of Channel 1 (on Timer 2)
```

## sound/arm/Kconfig
```kconfig
# ALSA ARM drivers

menuconfig SND_ARM
	bool "ARM sound devices"
	depends on ARM
	default y
	help
	  Support for sound devices specific to ARM architectures.
	  Drivers that are implemented on ASoC can be found in
	  "ALSA for SoC audio support" section.

if SND_ARM

config SND_TMPA9XX_I2S
	tristate

config SND_TMPA9XX_WM8974
	tristate "TMPA9xx WM8974 driver"
	depends on MACH_TONGA2_TFTTIMER && SND
	select SND_PCM
	select SND_TMPA9XX_I2S
	help
	  Say Y here if you have a Tonga2
          TFTTimer Board and want to use its
          WM8974 audio chip.

config SND_TMPA9XX_WM8976
	tristate "TMPA9xx WM8976 driver"
	depends on MACH_TOPASA900 && SND && I2C_TMPA9XX
	select SND_PCM
	select SND_TMPA9XX_I2S
	help
	  Say Y here if you have a Toshiba TopasA900
	  TMPA900 development board and
	  want to use its WM8976 audio chip.

config SND_TMPA9XX_WM8983
	tristate "TMPA9xx WM8983 driver"
	depends on MACH_TONGA && SND
	select SND_PCM
	select SND_TMPA9XX_I2S
	help
	  Say Y here if you have a Toshiba Tonga2 
	  TMPA900 CPU board and
	  want to use its WM8983 audio chip.

config SND_TMPA9XX_PCM1773
	tristate "TMPA9XX PCM1773 driver"
	depends on (MACH_TOPASA900 || MACH_TOPAS910) && SND
	select SND_PCM
	select SND_TMPA9XX_I2S
	help
	  Say Y here if you have a Toshiba TopasA900
	  TMPA900 development board and
	  want to use the TOPAS9xx PCM1773 audio chip.
          
config SND_ARMAACI
	tristate "ARM PrimeCell PL041 AC Link support"
	depends on ARM_AMBA
	select SND_PCM
	select SND_AC97_CODEC

config SND_PXA2XX_PCM
	tristate
	select SND_PCM

config SND_PXA2XX_LIB
	tristate
	select SND_AC97_CODEC if SND_PXA2XX_LIB_AC97

config SND_PXA2XX_LIB_AC97
	bool

config SND_PXA2XX_AC97
	tristate "AC97 driver for the Intel PXA2xx chip"
	depends on ARCH_PXA
	select SND_PXA2XX_PCM
	select SND_AC97_CODEC
	select SND_PXA2XX_LIB
	select SND_PXA2XX_LIB_AC97
	help
	  Say Y or M if you want to support any AC97 codec attached to
	  the PXA2xx AC97 interface.

endif	# SND_ARM
```

## sound/soc/tmpa9xx/Kconfig
```kconfig
#
# TMPA9xx I2S audio support
#
config SND_SOC_TMPA9XX
	tristate "SoC Audio for Toshiba TMPA9XX I2S"
	help
	  This option enables support for the I2S audio link interface
	  in Toshiba TMPA9xx SoCs.

config SND_SOC_TMPA9XX_I2S
	tristate

#
# Boards
#
config SND_SOC_TMPA9XX_TOPAS
	tristate "Support for Toshiba TOPAS reference board"
	depends on SND_SOC_TMPA9XX
	select SND_SOC_TMPA9XX_I2S
	select SND_SOC_WM8978
	help
	  This options adds support for the TOPAS9x0 reference designs
	  and their codecs.

config SND_SOC_TMPA9XX_GLYNBB
	tristate "Support for TMPA900 ARM9 SO-DIMM on Glyn baseboard"
	depends on SND_SOC_TMPA9XX
	select SND_SOC_TMPA9XX_I2S
	select SND_SOC_WM8983
	help
	  This options adds support for the TMPA900 ARM9 SO-DIMM board
	  attached to the baseboard by Glyn.
```
